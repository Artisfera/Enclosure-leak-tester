## CMakeLists.txt
```
cmake_minimum_required(VERSION 3.20.0)
find_package(Zephyr REQUIRED HINTS $ENV{ZEPHYR_BASE})

project(D6F-Read)

target_sources(app PRIVATE
    src/main.c
    src/adcin.c
    src/pwmout.c
    src/spiin.c
    src/pid.c
)
```

## prj.conf
```kconfig
CONFIG_ADC=y
CONFIG_LOG=n
CONFIG_LOG_DEFAULT_LEVEL=3
CONFIG_LOG_BACKEND_UART=y
CONFIG_CBPRINTF_FP_SUPPORT=y
CONFIG_PWM=y
CONFIG_SPI=y
CONFIG_GPIO=y
CONFIG_SHELL=y
CONFIG_LOG_RUNTIME_FILTERING=y
CONFIG_LOG_CMDS=y
CONFIG_LOG_MAX_LEVEL=3
```

## src/main.c
```c
#include <zephyr/kernel.h>
#include <zephyr/sys/util.h>
#include <zephyr/logging/log.h>
#include <stdio.h>

#include "adc.h"
#include "pwm.h"
#include "spi.h"
#include "pid.h"


LOG_MODULE_REGISTER(main, LOG_LEVEL_DBG);

int main(void)
{
    float pressure_pa = 0.0f;
    float duty = 0.0f;
    float l_min = 0.0f;
    float pidTerm = 0.0f;
    //printf("Hello World!\n");
    
    pidParm enclosure1 = {
        .Kp = 0.5f,
        .Ki = 0.01f,
        .Kd = 1.0f,
        .SetPoint = 50.0f,
    };
    
    uint8_t err;   
    err = adc_init();
    if (err != 0){
        LOG_ERR("ADC failed with code error: %d", err);
        return -1;
    };

    err = spi_init();
    if (err != 0){
        LOG_ERR("SPI failed with code error: %d", err);
        return -1;
    };

    pid_init();

    


    while (1) {
        adc_read_flowrate(&l_min);

        spi_read_pressure(&pressure_pa);
        printf(">Pressure:%.4f,", (double)pressure_pa);
        pid_calc(pressure_pa, &pidTerm, enclosure1);

        duty = 5.0f + pidTerm;
        duty = CLAMP(duty, 0.0f, 20.0f);

        pwm_set_percent(duty);

        // printf(">Pressure:%.4f,pidTerm:%.4f,duty:%.4f,l_min:%.4f\r\n",
        //     (double)pressure_pa,
        //     (double)pidTerm,
        //     (double)duty,
        //     (double)l_min);
   // k_msleep(100);
}

    return 0;
}
```

## src/adc.c
```c
#include <zephyr/kernel.h>
#include <zephyr/drivers/adc.h>
#include <zephyr/dt-bindings/adc/nrf-saadc.h>
#include <zephyr/logging/log.h>

#include "adc.h"

LOG_MODULE_REGISTER(adc, LOG_LEVEL_DBG);

static const struct device *adc = DEVICE_DT_GET(DT_NODELABEL(adc));

static const struct adc_channel_cfg channel_cfg = {
        .input_positive = NRF_SAADC_AIN7,
        .gain = ADC_GAIN_1_5,
        .reference = ADC_REF_INTERNAL,
        .acquisition_time = ADC_ACQ_TIME_DEFAULT,
        .channel_id = 0,
        .differential = 0,
};

static int16_t sample;

static struct adc_sequence sequence = {
        .channels = BIT(0),
        .buffer = &sample,
        .buffer_size = sizeof(sample),
        .resolution = 14,
        .oversampling = 6,
};


int adc_init(void)
{
    int err;

    err = adc_channel_setup(adc, &channel_cfg);

    if (err <= 0) {
            LOG_ERR("ADC channel setup failed: %d", err);
            return ADC_CH_SETUP_ERR;
    }

    sequence.calibrate = true;
    
    err = adc_read(adc, &sequence);

    if (err < 0) {
            LOG_ERR("ADC calibration failed: %d", err);
            return ADC_READ_ERR;
    }

    sequence.calibrate = false;

        return ADC_OK;
}


int adc_read_flowrate(float *l_min)
{
    int err;

    err = adc_read(adc, &sequence);

    if (err < 0) {
        LOG_ERR("ADC read failed: %d", err);
        return ADC_READ_ERR;
    }

        int32_t voltage_mv = sample;

        float voltage = voltage_mv / 1000.0f;
        *l_min = (((((0.094003f * voltage - 0.564312f) * voltage
                  + 1.374705f) * voltage
                  - 1.601495f) * voltage
                  + 1.060657f) * voltage
                  - 0.269996f)
                  * 100.0f;

        return ADC_OK;
}
```

## src/adc.h
```c
#ifndef ADC_H_
#define ADC_H_

int adc_init(void);
int adc_read_flowrate(float *l_min);

#endif
```

## src/adcin.c
```c
#include <zephyr/kernel.h>
#include <zephyr/drivers/adc.h>
#include <zephyr/dt-bindings/adc/nrf-saadc.h>
#include <zephyr/logging/log.h>

LOG_MODULE_REGISTER(adc, LOG_LEVEL_DBG);

static const struct device *adc = DEVICE_DT_GET(DT_NODELABEL(adc));

static const struct adc_channel_cfg channel_cfg = {
        .input_positive = NRF_SAADC_AIN7,
        .gain = ADC_GAIN_1_5,
        .reference = ADC_REF_INTERNAL,
        .acquisition_time = ADC_ACQ_TIME_DEFAULT,
        .channel_id = 0,
        .differential = 0,
};

static int16_t sample;

static struct adc_sequence sequence = {
        .channels = BIT(0),
        .buffer = &sample,
        .buffer_size = sizeof(sample),
        .resolution = 14,
        .oversampling = 6,
};


int adc_init(void)
{
        int err = adc_channel_setup(adc, &channel_cfg);

        if (err < 0) {
                LOG_ERR("ADC channel setup failed: %d", err);
                return err;
        }

        sequence.calibrate = true;

        err = adc_read(adc, &sequence);

        sequence.calibrate = false;

        if (err < 0) {
                LOG_ERR("ADC calibration failed: %d", err);
                return err;
        }

        return 0;
}


int adc_read_flowrate(int *ml_min)
{
        int err = adc_read(adc, &sequence);

        if (err < 0) {
                LOG_ERR("ADC read failed: %d", err);
                return err;
        }

        int32_t voltage_mv = sample;

        err = adc_raw_to_millivolts(
                600,
                channel_cfg.gain,
                sequence.resolution,
                &voltage_mv
        );

        if (err < 0) {
                LOG_ERR("ADC conversion failed: %d", err);
                return err;
        }

        //*ml_min = (voltage_mv - 500) / 20;
        *ml_min = voltage_mv;

        /*if (*ml_min > 100) {
                LOG_ERR("Flow is too HIGH! - %d ml/min", *ml_min);
        } else {
                LOG_DBG("Voltage: %d mV", voltage_mv);
                LOG_DBG("Flow: %d ml/min", *ml_min);
        }*/

        return 0;
}
```

## src/pid.c
```c
#include <zephyr/kernel.h>
#include <zephyr/sys/util.h>

#include "pid.h"

static int64_t prev_time;
static float integral = 0.0f;
static float previousError = 0.0f;


int pid_init(void)
{
    prev_time = k_uptime_get();

    return 0;
}


int pid_calc(float pressure_pa, float *pidTerm, pidParm pidparm)
{
    float error = pidparm.SetPoint - pressure_pa;

    float pTerm = pidparm.Kp * error;

    float derivative = 0.0f;



    float dt = (float)k_uptime_delta(&prev_time) / 1000.0f;
    if (dt <= 0.0f) {
     dt = 0.001f;
    }

    integral += error * dt;

    //integral = CLAMP(integral, -0.25f, 0.25f);

    float iTerm = pidparm.Ki * integral;

    derivative = (error - previousError) / dt;
    float dTerm = pidparm.Kd * derivative;

    previousError = error;

    *pidTerm = pTerm + iTerm + dTerm;

    printf("pTerm:%.4f,iTerm:%.4f,dTerm:%.4f,SetPoint:%.4f,pidTerm:%.4f\r\n",
        pTerm,
        iTerm,
        dTerm,
        pidparm.SetPoint,
        pidTerm);

    return 0;
}
```

## src/pid.h
```c
#ifndef PID_H_
#define PID_H_

typedef struct {
    float Kp;
    float Ki;
    float Kd;
    float SetPoint;
} pidParm;

extern pidParm enclosure1;

int pid_init(void);
int pid_calc(float psi, float *pidTerm, pidParm pidparm);

#endif
```

## src/pwm.c
```c
#include <zephyr/kernel.h>
#include <zephyr/drivers/pwm.h>
#include <zephyr/logging/log.h>
LOG_MODULE_REGISTER(pwm, LOG_LEVEL_DBG);

#include "pwm.h"

static const struct device *pwm0_motor = DEVICE_DT_GET(DT_NODELABEL(pwm0));


int pwm_set_percent(float duty)
{
    uint32_t period = PWM_KHZ(25);
    uint32_t pulse = (uint32_t)((period * duty) / 100.0f);

    LOG_DBG("Duty: %.2f", duty);

    int err = pwm_set(
        pwm0_motor,
        0,
        period,
        pulse,
        PWM_POLARITY_NORMAL
    );

    if (err < 0) {
        LOG_ERR("PWM set failed: %d", err);
        return PWM_SET_ERR;
    }

    return PWM_OK;

}
```

## src/spi.c
```c
#include <zephyr/kernel.h>
#include <zephyr/drivers/spi.h>
#include <zephyr/devicetree.h>
#include <zephyr/logging/log.h>
LOG_MODULE_REGISTER(spi, LOG_LEVEL_DBG);

#include "spi.h"

#define SPIOP SPI_WORD_SET(8) | SPI_TRANSFER_MSB
struct spi_dt_spec sensor_pressure = SPI_DT_SPEC_GET(DT_NODELABEL(sensor_pressure), SPIOP);


int spi_init(void)
{
    bool ready;

    ready = spi_is_ready_dt(&sensor_pressure);

    if (!ready) {
        LOG_ERR("SPI interface: NOT READY");
        return SPI_INTERFACE_ERR;
    }


    LOG_INF("SPI interface: READY");

        return SPI_OK;
}

int spi_read_pressure(float *pressure_pa)
{
    uint8_t rx_data[2] = {0};

    struct spi_buf rx_buf = {
        .buf = rx_data,
        .len = sizeof(rx_data)
    };

    struct spi_buf_set rx = {
        .buffers = &rx_buf,
        .count = 1
    };

    int err;

        err = spi_read_dt(&sensor_pressure, &rx);

        if (err < 0) {
        LOG_ERR("SPI read failed: %d", err);
        return SPI_READ_ERR;
        }

    uint8_t status = rx_data[0] >> 6;

    LOG_DBG("SPI read data: %02X %02X", rx_data[0], rx_data[1]);
    LOG_DBG("SPI read status: %d", status);

    // if (status != 0) {
    //     LOG_ERR("Sensor status error: %d", status);
    //     return SENSOR_STATUS_ERR;
    // }

    int output = (rx_data[0] & 0x3F) * 256 + rx_data[1];

    *pressure_pa = -498.18f + ((output - 1638.0f) * (996.36f / 13108.0f));

    LOG_DBG("Pressure: %.2f Pa", (double)*pressure_pa);

    return SPI_OK;
}
```

## src/spi.h
```c
#ifndef SPI_H_
#define SPI_H_

typedef enum {
    SPI_OK, 
    SPI_INTERFACE_ERR, 
    SPI_READ_ERR, 
    SENSOR_STATUS_ERR,
} spi_status;

int spi_init(void);
int spi_read_pressure(float *psi);


#endif
```
